## KeyboardGW.old/sdkconfig.defaults
```kconfig
# Custom TinyUSB composite configuration for ESP32-S3
CONFIG_IDF_TARGET="esp32s3"

# ESP32-S3 USB Serial/JTAG を完全無効化
CONFIG_ESP_CONSOLE_UART_DEFAULT=y
CONFIG_ESP_CONSOLE_UART_NUM=0
CONFIG_ESP_CONSOLE_USB_SERIAL_JTAG=n
CONFIG_ESP_CONSOLE_SECONDARY_NONE=y
CONFIG_ESP32S3_USB_OTG_SUPPORTED=y
# 重要：USB Serial/JTAGドライバ自体を無効化
CONFIG_USB_SERIAL_JTAG_ENABLED=n

# ブートローダーレベルでもUSB Serial/JTAG無効化
CONFIG_BOOTLOADER_LOG_LEVEL_NONE=y
CONFIG_LOG_DEFAULT_LEVEL_NONE=y
CONFIG_ESP32S3_DEBUG_OCDAWARE=n

# USB機能を完全にTinyUSBに移管
CONFIG_USB_ENABLED=y
CONFIG_ESP32S3_USB_OTG_ENABLED=y
CONFIG_USB_DEVICE_VID=0x303A
CONFIG_USB_DEVICE_PID=0x0002
CONFIG_USB_DESC_CUSTOM_PID=0x0002
CONFIG_TINYUSB_ENABLED=y
CONFIG_TINYUSB_DESC_ENABLED=y
CONFIG_TINYUSB_DESC_CUSTOM_VID=0x303A
CONFIG_TINYUSB_DESC_CUSTOM_PID=0x0002
CONFIG_TINYUSB_DESC_MANUFACTURER_STRING="Espressif Systems"
CONFIG_TINYUSB_DESC_PRODUCT_STRING="ESP32-S3 HID CDC"
CONFIG_TINYUSB_DESC_SERIAL_STRING="123456"
CONFIG_TINYUSB_DESC_CDC_STRING="CDC Interface"
CONFIG_TINYUSB_DESC_HID_STRING="HID Keyboard"
CONFIG_TINYUSB_CDC_ENABLED=y
CONFIG_TINYUSB_CDC_RX_BUFSIZE=256
CONFIG_TINYUSB_CDC_TX_BUFSIZE=256
CONFIG_TINYUSB_CDC_COUNT=1
CONFIG_TINYUSB_HID_ENABLED=y
CONFIG_TINYUSB_HID_COUNT=1
CONFIG_TINYUSB_HID_KEYBOARD_ENABLED=y
CONFIG_TINYUSB_HID_BOOT_PROTOCOL=y

# ESP-IDF USB Serial/JTAG完全無効化
CONFIG_ESP_CONSOLE_UART_DEFAULT=y
CONFIG_ESP_CONSOLE_USB_SERIAL_JTAG=n
CONFIG_ESP_CONSOLE_SECONDARY_NONE=y
CONFIG_USJ_ENABLE_USB_SERIAL_JTAG=n
```

## KeyboardGW/sdkconfig.defaults
```kconfig
# Custom TinyUSB composite configuration for ESP32-S3
CONFIG_IDF_TARGET="esp32s3"
CONFIG_USB_ENABLED=y
CONFIG_ESP32S3_USB_OTG_ENABLED=y
CONFIG_USB_DEVICE_VID=0x303A
CONFIG_USB_DEVICE_PID=0x0002
CONFIG_USB_DESC_CUSTOM_PID=0x0002
CONFIG_TINYUSB_ENABLED=y
CONFIG_TINYUSB_DESC_ENABLED=y
CONFIG_TINYUSB_DESC_CUSTOM_VID=0x303A
CONFIG_TINYUSB_DESC_CUSTOM_PID=0x0002
CONFIG_TINYUSB_DESC_MANUFACTURER_STRING="Espressif Systems"
CONFIG_TINYUSB_DESC_PRODUCT_STRING="ESP32-S3 HID CDC"
CONFIG_TINYUSB_DESC_SERIAL_STRING="123456"
CONFIG_TINYUSB_DESC_CDC_STRING="CDC Interface"
CONFIG_TINYUSB_DESC_HID_STRING="HID Keyboard"
CONFIG_TINYUSB_CDC_ENABLED=y
CONFIG_TINYUSB_CDC_RX_BUFSIZE=256
CONFIG_TINYUSB_CDC_TX_BUFSIZE=256
CONFIG_TINYUSB_CDC_COUNT=1
CONFIG_TINYUSB_HID_ENABLED=y
CONFIG_TINYUSB_HID_COUNT=1
CONFIG_TINYUSB_HID_KEYBOARD_ENABLED=y
CONFIG_TINYUSB_HID_BOOT_PROTOCOL=y
```
